## boards/uiapduino/samples/pixpaper_213m/apps/pong/sample.yaml
```yaml
sample:
  name: pixpaper-213m e-paper - pong game (partial update)
  description: >
    Paddle-ball (pong-style) game on the Open-EP pixpaper-213m 2.13"
    monochrome e-paper panel, controlled over the UART console. The most
    demanding partial-update demo here: a ball sweeping the screen every
    frame on an inverted (black) court, driven with the dual-plane sync
    discipline.
tests:
  sample.boards.uiap.uiapduino.pixpaper_213m.pong:
    platform_allow:
      - uiapduino_pro_micro_ch32v003
    tags:
      - gpio
      - uart
      - displays
    depends_on:
      - gpio
    build_only: true
```

## boards/uiapduino/samples/pixpaper_213m/apps/snake/sample.yaml
```yaml
sample:
  name: pixpaper-213m e-paper - snake game (partial update)
  description: >
    Snake game on the Open-EP pixpaper-213m 2.13" monochrome e-paper panel,
    steered over the UART console. Demonstrates flicker-free partial updates
    on a moving object: custom partial LUT, per-frame diff-driving of only
    the changed cells, and the 0x24/0x26 dual-plane sync discipline.
tests:
  sample.boards.uiap.uiapduino.pixpaper_213m.snake:
    platform_allow:
      - uiapduino_pro_micro_ch32v003
    tags:
      - gpio
      - uart
      - displays
    depends_on:
      - gpio
    build_only: true
```

## boards/uiapduino/samples/pixpaper_213m/apps/tictactoe/sample.yaml
```yaml
sample:
  name: pixpaper-213m e-paper - tic-tac-toe game (partial update)
  description: >
    Tic-tac-toe against the computer on the Open-EP pixpaper-213m 2.13"
    monochrome e-paper panel, controlled over the UART console. The selection
    cursor moves with fast partial updates; every placed move triggers one
    full refresh, so pieces are drawn once and never erased.
tests:
  sample.boards.uiap.uiapduino.pixpaper_213m.tictactoe:
    platform_allow:
      - uiapduino_pro_micro_ch32v003
    tags:
      - gpio
      - uart
      - displays
    depends_on:
      - gpio
    build_only: true
```
