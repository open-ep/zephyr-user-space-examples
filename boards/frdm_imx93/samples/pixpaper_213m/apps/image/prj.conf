## CMakeLists.txt
```
# SPDX-License-Identifier: Apache-2.0

cmake_minimum_required(VERSION 3.20.0)

# Panel wiring is shared by all pixpaper_213m apps; it lives in ../../common/.
set(EXTRA_DTC_OVERLAY_FILE ${CMAKE_CURRENT_SOURCE_DIR}/../../common/frdm_imx93_mimx9352_m33.overlay)

find_package(Zephyr REQUIRED HINTS $ENV{ZEPHYR_BASE})
project(pixpaper_213m_image)

target_sources(app PRIVATE src/main.c)
```

## sample.yaml
```
sample:
  name: pixpaper-213m e-paper - image (raw SPI)
  description: >
    Show a bundled image on the Open-EP pixpaper-213m 2.13" monochrome e-paper
    panel, driven over raw LPSPI on the FRDM-IMX93 Cortex-M33.
tests:
  sample.boards.nxp.frdm_imx93.pixpaper_213m.image:
    platform_allow:
      - frdm_imx93/mimx9352/m33
    tags:
      - spi
      - gpio
      - displays
    depends_on:
      - spi
      - gpio
    build_only: true
```

## prj.conf
```kconfig
CONFIG_GPIO=y
CONFIG_SPI=y
CONFIG_SPI_NXP_LPSPI=y

CONFIG_LOG=y

CONFIG_MAIN_STACK_SIZE=4096
```

## src/main.c
```c
/*
 * SPDX-License-Identifier: Apache-2.0
 *
 * Open-EP pixpaper-213m (2.13", 250x122) e-paper driver for FRDM-IMX93 / M33.
 * Framebuffer is column-major: 250 gates x 16 source bytes = 4000 bytes, 1 = white.
 */

#include <zephyr/kernel.h>
#include <zephyr/device.h>
#include <zephyr/drivers/spi.h>
#include <zephyr/drivers/gpio.h>
#include <zephyr/logging/log.h>
#include <zephyr/sys/util.h>
#include <errno.h>
#include <string.h>
#include "png_HEX.h"

LOG_MODULE_REGISTER(pixpaper_213m, LOG_LEVEL_INF);

#define EPD_NODE DT_NODELABEL(epd)

static const struct spi_dt_spec epd_spi =
	SPI_DT_SPEC_GET(EPD_NODE, SPI_WORD_SET(8) | SPI_TRANSFER_MSB);
static const struct gpio_dt_spec dc_gpio = GPIO_DT_SPEC_GET(EPD_NODE, dc_gpios);
static const struct gpio_dt_spec rst_gpio = GPIO_DT_SPEC_GET(EPD_NODE, reset_gpios);
static const struct gpio_dt_spec busy_gpio = GPIO_DT_SPEC_GET(EPD_NODE, busy_gpios);

/* Panel RAM: 250 gate lines x 128 source bits (16 bytes) each. */
#define EPD_GATES     250
#define EPD_SRC       128
#define EPD_SRC_BYTES (EPD_SRC / 8)
#define EPD_FB_SIZE   (EPD_GATES * EPD_SRC_BYTES)

/* This SoC's LPSPI corrupts single transfers longer than 10 bytes, so the RAM
 * data phase is sent in chunks (8 leaves margin and is ~8x faster than 1 byte).
 */
#define EPD_CHUNK     8

static uint8_t framebuf[EPD_FB_SIZE];

static int spi_tx(const uint8_t *data, size_t len)
{
	struct spi_buf buf = { .buf = (void *)data, .len = len };
	struct spi_buf_set set = { .buffers = &buf, .count = 1 };
	int ret = spi_write_dt(&epd_spi, &set);

	if (ret < 0) {
		LOG_ERR("SPI write failed: %d", ret);
	}
	return ret;
}

static void epd_cmd(uint8_t cmd)
{
	gpio_pin_set_dt(&dc_gpio, 0);
	k_busy_wait(1);
	spi_tx(&cmd, 1);
}

static void epd_data(uint8_t d)
{
	gpio_pin_set_dt(&dc_gpio, 1);
	k_busy_wait(1);
	spi_tx(&d, 1);
}

static void epd_wait_idle(void)
{
	k_msleep(2);
	/* BUSY high = busy; bail out after ~10s so a stuck panel can't hang us. */
	for (int i = 0; i < 1000; i++) {
		if (gpio_pin_get_dt(&busy_gpio) == 0) {
			return;
		}
		k_msleep(10);
	}
	LOG_WRN("BUSY stuck high - continuing anyway");
}

static void epd_hw_reset(void)
{
	k_msleep(50);
	gpio_pin_set_dt(&rst_gpio, 0);
	k_msleep(50);
	gpio_pin_set_dt(&rst_gpio, 1);
	k_msleep(50);
}

static void epd_init(void)
{
	epd_hw_reset();
	k_msleep(1000);
	epd_wait_idle();

	epd_cmd(0x12);			/* SW reset */
	epd_wait_idle();

	epd_cmd(0x01);			/* driver output: 0xF9+1 = 250 gates */
	epd_data(0xF9);
	epd_data(0x00);
	epd_data(0x00);

	epd_cmd(0x11);			/* data entry mode: X+, Y- */
	epd_data(0x01);

	epd_cmd(0x44);			/* RAM X range: 0 .. 15 (16 bytes) */
	epd_data(0x00);
	epd_data(0x0F);

	epd_cmd(0x45);			/* RAM Y range: 249 .. 0 */
	epd_data(0xF9);
	epd_data(0x00);
	epd_data(0x00);
	epd_data(0x00);

	epd_cmd(0x3C);			/* border waveform */
	epd_data(0x05);

	epd_cmd(0x21);			/* display update control 1 */
	epd_data(0x00);
	epd_data(0x80);

	epd_cmd(0x18);			/* internal temperature sensor */
	epd_data(0x80);

	epd_cmd(0x4E);			/* RAM X counter */
	epd_data(0x00);

	epd_cmd(0x4F);			/* RAM Y counter: 249 */
	epd_data(0xF9);
	epd_data(0x00);

	epd_wait_idle();
}

static void epd_refresh(void)
{
	epd_cmd(0x24);			/* write RAM (B/W) */
	k_msleep(10);
	gpio_pin_set_dt(&dc_gpio, 1);
	for (size_t i = 0; i < sizeof(framebuf); i += EPD_CHUNK) {
		spi_tx(&framebuf[i], MIN(EPD_CHUNK, sizeof(framebuf) - i));
	}

	epd_cmd(0x22);			/* display update control 2 */
	k_msleep(10);
	epd_data(0xF7);
	epd_cmd(0x20);			/* master activation */
	epd_wait_idle();
}

/* Set one pixel. gate: 0..249, src: 0..127. white = set bit. */
static void fb_set(int gate, int src, bool white)
{
	uint8_t *byte = &framebuf[gate * EPD_SRC_BYTES + (src / 8)];
	uint8_t mask = 1u << (7 - (src % 8));

	if (white) {
		*byte |= mask;
	} else {
		*byte &= ~mask;
	}
}

static void fb_uniform(bool white)
{
	memset(framebuf, white ? 0xFF : 0x00, sizeof(framebuf));
}

/* png_HEX.h: img0[] holds the image as IMG_H rows of IMG_CHUNKS uint32 words,
 * MSB-first across IMG_W columns; bit 1 = white. Image width maps to the gate
 * axis, height to the source axis; the rest of the panel is padded white.
 * IMG_W / IMG_H are defined by png_HEX.h.
 */
#define IMG_CHUNKS ((IMG_W + 31) / 32)

static bool img_white(int gate, int src)
{
	if (gate >= IMG_W || src >= IMG_H) {
		return true; /* pad white */
	}

	return (img0[src * IMG_CHUNKS + (gate / 32)] >> (31 - (gate % 32))) & 1u;
}

static void fb_image(void)
{
	for (int g = 0; g < EPD_GATES; g++) {
		for (int s = 0; s < EPD_SRC; s++) {
			fb_set(g, s, img_white(g, s));
		}
	}
}

int main(void)
{
	if (!spi_is_ready_dt(&epd_spi)) {
		LOG_ERR("SPI bus not ready");
		return -ENODEV;
	}
	if (!gpio_is_ready_dt(&dc_gpio) || !gpio_is_ready_dt(&rst_gpio) ||
	    !gpio_is_ready_dt(&busy_gpio)) {
		LOG_ERR("GPIO not ready");
		return -ENODEV;
	}

	if (gpio_pin_configure_dt(&dc_gpio, GPIO_OUTPUT_INACTIVE) < 0 ||
	    gpio_pin_configure_dt(&rst_gpio, GPIO_OUTPUT_ACTIVE) < 0 ||
	    gpio_pin_configure_dt(&busy_gpio, GPIO_INPUT) < 0) {
		LOG_ERR("GPIO configure failed");
		return -EIO;
	}

	LOG_INF("Initializing pixpaper-213m over LPSPI3...");
	epd_init();
	LOG_INF("Init done");

	/* Clear to white first to avoid ghosting, then show the image. */
	fb_uniform(true);
	epd_refresh();
	LOG_INF("Cleared to white");

	fb_image();
	epd_refresh();
	LOG_INF("Displayed image (%ux%u)", IMG_W, IMG_H);

	/* E-paper retains the image with no power; nothing more to do. */
	k_sleep(K_FOREVER);

	return 0;
}
```

## src/png_HEX.h
```c
#ifndef PNG_HEX_H
#define PNG_HEX_H

#include <stdint.h>

// Image data for: test.png
// Dimensions: 211 x 103
#define IMG_W 211
#define IMG_H 103

static const uint32_t img0[] = {
    0xFFFFFFFF, 0xFFFFFFFF, 0xFFFFFFFF, 0xFFFFFFFF, 0xFFFFFFFF, 0xFFFFFFFF, 0xFFFFE000, 
    0xFFFFFFFF, 0xFFFFFFFF, 0xFFFFFFFF, 0xFFFFFFFF, 0xFFFFFFFF, 0xFFFFFFFF, 0xFFFFE000, 
    0xFFFFFFFF, 0xFFFFFFFF, 0xFFFFFFFF, 0xFFFFFFFF, 0xFFFFFFFF, 0xFFFFFFFF, 0xFFFFE000, 
    0xFFFFFFFF, 0xFFFFFFFF, 0xFFFFFFFF, 0xFFFFFFFF, 0xFFFFFFFF, 0xFFFFFFFF, 0xFFFFE000, 
    0xFFFFFFFF, 0xFFFFFFFF, 0xFFFFFFFF, 0xFFFFFFFF, 0xFFFFFFFF, 0xFFFFFFFF, 0xFFFFE000, 
    0xFFFFFFFF, 0xFFFFFFFF, 0xFFFFFFFF, 0xFFFFFFFF, 0xFFFFFFFF, 0xFFFFFFFF, 0xFFFFE000, 
    0xFFFFFFFF, 0xFFFFFFFF, 0xFFFFFFFF, 0xFFFFFFFF, 0xFFFFFFFF, 0xFFFFFFFF, 0xFFFFE000, 
    0xFFFFFFFF, 0xFFFFFFFF, 0xFFFFFFFF, 0xFFFFFFFF, 0xFFFFFFFF, 0xFFFFFFFF, 0xFFFFE000, 
    0xFFFFFFFF, 0xFFFFFFFF, 0xFFFFFFFF, 0xFFFFFFEF, 0xFFFFFFFF, 0xF7FFFFFF, 0xFFFFE000, 
    0xFCF9FFFF, 0xFFFFF7FF, 0xFFFFFF80, 0x07FF9F7F, 0xFFFFFE7F, 0xDBFFFFFF, 0xFF3FE000, 
    0xFDF9FFFF, 0xFFFFF7EF, 0xFFFFFF80, 0x07FF9FBF, 0xFFFFFE7F, 0xDFFFFFFF, 0xCF3FE000, 
    0xFDF9FFFF, 0xFFFFF7FF, 0xC0007FFF, 0xFFFF9FFF, 0xFFFFFE7F, 0xFFFFFFFF, 0xEF3FE000, 
    0xFDF9FFFF, 0xFFFFF7FF, 0xC0007FFF, 0xFFFF9FFF, 0xFFFFFE7F, 0xFFFFFFFF, 0xEF3FE000, 
    0xC0001FFF, 0xFFF0000F, 0xCFFE7FFF, 0xFFE0003F, 0xFFFFFE7F, 0x9FFFFFFF, 0xCF3FE000, 
    0xC0001FFC, 0xFFF0000F, 0xCFFE7FFF, 0xFFE0003F, 0xFFFFFE7C, 0x1FFFFFFF, 0xCF3FE000, 
    0xFDF9FF9C, 0xFBFFF7FF, 0xCFFE7E00, 0x03FF9F3F, 0xFFFFFE60, 0xFFFFFFFF, 0xCF3FE000, 
    0xFDF9FFDE, 0xF3FFF7FF, 0xCFFE7E00, 0x03FFBF3F, 0x00007E03, 0xFFC0001F, 0xCF3FE000, 
    0xFDF9FFDE, 0xF3FFF7FF, 0xCFFE7FFF, 0xF7FFBF3F, 0x00007E3F, 0xFFC0001F, 0xCF3FE000, 
    0xFDF9FFCF, 0xF7FEF79F, 0xCFFE7FFF, 0xE7FF3F3F, 0x00007E7F, 0xFFC0001F, 0xCF3FE000, 
    0xFCF9FFFF, 0xE7FCF7DF, 0xCFFE7FFF, 0xE7FF3F3F, 0xFFFFFE7F, 0xFFFFFFFF, 0xCF3EE000, 
    0xFFF9FFFF, 0xEFF9F7CF, 0xCFFE7FFF, 0xCFFE7F3F, 0xFFFFFE7F, 0xFFFFFFFF, 0x9F3CE000, 
    0xFFFBFFFF, 0xCFFBF7EF, 0xCFFE7FFF, 0x9FFE7F3F, 0xFFFFFE7F, 0xFFFFFFFF, 0x9F31E000, 
    0xFFF3FFFF, 0x9FF3F7E7, 0xCFFE7FFF, 0x3FFCFF3F, 0xFFFFFE7F, 0xFFFFFFFF, 0x3F03E000, 
    0xFFE7FFFF, 0x3FFFF7FF, 0xC0007FFE, 0x7FF9FF7F, 0xFFFFFE7F, 0xFFFFFFFF, 0x3F0FE000, 
    0xFFCFFFFC, 0x7FFFE7FF, 0xC0007FF8, 0xFFF1F07F, 0xFFFFFE00, 0x0FFFFFFE, 0x7F1FE000, 
    0xFF1FFFF1, 0xFFFF87FF, 0xCFFE7FE3, 0xFFF3F0FF, 0xFFFFFF00, 0x0FFFFFFF, 0xFFFFE000, 
    0xFFFFFFFB, 0xFFFFFFFF, 0xFFFFFFFF, 0xFFFFFFFF, 0xFFFFFFFF, 0xFFFFFFFF, 0xFFFFE000, 
    0xFFFFFFFF, 0xFFFFFFFF, 0xFFFFFFFF, 0xFFFFFFFF, 0xFFFFFFFF, 0xFFFFFFFF, 0xFFFFE000, 
    0xFFFFFFFF, 0xFFFFFFFF, 0xFFFFFFFF, 0xFFFFFFFF, 0xFFFFFFFF, 0xFFFFFFFF, 0xFFFFE000, 
    0xFFFFFFFF, 0xFFFFFFFF, 0xFFFFFFFF, 0xFFFFFFFF, 0xFFFFFFFF, 0xFFFFFFFF, 0xFFFFE000, 
    0xFFFFFFFF, 0xFFFFFFFF, 0xFFFFFFFF, 0xFFFFFFFF, 0xFFFFFFFF, 0xFFFFFFFF, 0xFFFFE000, 
    0xFFFFFFFF, 0xFFFFFFFF, 0xFFFFFFFF, 0xFFFFFFFF, 0xFFFFFFFF, 0xFFFFFFFF, 0xFFFFE000, 
    0xFFFFFFFF, 0xFFFFFFFF, 0xFFFFFFFF, 0xFFFFFFFF, 0xFFFFFFFF, 0xFFFFFFFF, 0xFFFFE000, 
    0xFFFFFFFF, 0xFFFFFFFF, 0xFFFFFFFF, 0xFFFFFFFF, 0xFFFFFFFF, 0xFFFFFFFF, 0xFFFFE000, 
    0xFFFFFFFF, 0xFFFFF3FF, 0xFFFFFFFF, 0xFFFFFFFF, 0xFFFFFFFF, 0xFFFFFFFF, 0xFFFFE000, 
    0xF03FFFFF, 0xFFFFF3FF, 0xFFFFFFFF, 0xFFFFFFFF, 0xFFFFFFFF, 0xFFFFFFFF, 0xFFFFE000, 
    0xF03E0F83, 0xFFFFF3FF, 0xFFFFFFFF, 0xFFFFFFFF, 0xFFFFFFFF, 0xFFFFFFFF, 0xFFFFE000, 
    0xF7FDEF7B, 0xFFFFF3FF, 0xFFFFFFFF, 0xFFFFFFFF, 0xFFFFFFFF, 0xFFFFFFFF, 0xFFFFE000, 
    0xF7FDE779, 0xDFFFF3FF, 0xFFFFFFFF, 0xFFFFFFFF, 0xFFFFFFFF, 0xFFFFFFFF, 0xFFFFE000, 
    0xF7F9E679, 0xC001F3FF, 0xFFFFFFFF, 0xFFFFFFFF, 0xFFFFFFFF, 0xFFFFFFFF, 0xFFFFE000, 
    0xF0F9E679, 0xCF3CF3FF, 0xFFFFFFFF, 0xFFFE01FF, 0xFFFFC01F, 0xFFFE03FF, 0xFFFFE000, 
    0xF039E679, 0xCF3CF3FF, 0xFFFFFFFF, 0xFFF8007F, 0xFFFFC01F, 0xFFF0007F, 0xFFFFE000, 
    0xFF99E679, 0xCF3CF3FF, 0xFFFFFFFF, 0xFFE0001F, 0xFFFF803F, 0xFFE0001F, 0xFFFFE000, 
    0xFF99E679, 0xCF3CF3FF, 0xFFFFFFFF, 0xFFC0000F, 0xFFFF803F, 0xFF80000F, 0xFFFFE000, 
    0xFF9DE779, 0xCF3CF3FF, 0xFFFFFFFF, 0xFF800007, 0xFFFF007F, 0xFF000007, 0xFFFFE000, 
    0xFFBDEF7B, 0xCF3CF3FF, 0xFFFFFFFF, 0xFF000007, 0xFFFF007F, 0xFE000003, 0xFFFFE000, 
    0xE03E0F83, 0xCF3CF3FF, 0xFFFFFFFF, 0xFF000003, 0xFFFE007F, 0xFE000003, 0xFFFFE000, 
    0xFFFFFFFF, 0xCF3CF3FF, 0xFFFFFFFF, 0xFE000001, 0xFFFE00FF, 0xFC000001, 0xFFFFE000, 
    0xFFFFFFFF, 0xFFFFFFFF, 0xFFFFFFFF, 0xFE000001, 0xFFFC00FF, 0xFC000001, 0xFFFFE000, 
    0xFFFFFFFF, 0xFFFFFFFF, 0xFFFFFFFF, 0xFC000001, 0xFFFC01FF, 0xFC01F800, 0xFFFFE000, 
    0xFFFFFFFF, 0xFFFFFFFF, 0xFFFFFFFF, 0xFC00F800, 0xFFF801FF, 0xF801FC00, 0xFFFFE000, 
    0xFFFFFFFF, 0xFFFFFFFF, 0xFFFFFFFF, 0xFC01FC00, 0xFFF803FF, 0xF803FE00, 0xFFFFE000, 
    0xFFFFFFFF, 0xFFFFFFFF, 0xFFFFFFFF, 0xFC01FC00, 0xFFF003FF, 0xF803FE00, 0xFFFFE000, 
    0xFFFFFFFF, 0xFFFFFFFF, 0xFFFFFFFF, 0xF803FE00, 0xFFF007FF, 0xF803FE00, 0xFFFFE000, 
    0xFFFFFFFF, 0xFFFFFFFF, 0xFFFFFFFF, 0xF803FE00, 0xFFE007FF, 0xF803FE00, 0xFFFFE000, 
    0xFFFFFFFF, 0xFFFFFFFF, 0xFFFFFFFF, 0xF803FE00, 0xFFE00FFF, 0xF803FE00, 0xFFFFE000, 
    0xFFFFFFFF, 0xFFFFFFFF, 0xFFFFFFFF, 0xF803FE00, 0xFFC00FFF, 0xF803FE00, 0xFFFFE000, 
    0xFFFFFFFF, 0xFFFFFFFF, 0xFFFFFFFF, 0xF007FE00, 0xFFC01FFF, 0xF803FE00, 0xFFFFE000, 
    0xFFFFFFFF, 0xFFFFFFFF, 0xFFFFFFFF, 0xF007FE00, 0xFF8001FF, 0xFC01FC00, 0xFFFFE000, 
    0xFFFFFFFF, 0xFFFFFFFF, 0xFFFFFFFF, 0xF007FC00, 0xFF80003F, 0xFC00F801, 0xFFFFE000, 
    0xFFFFFFFF, 0xFFFFFFFF, 0xFFFFFFFF, 0xFFFFFC00, 0xFF00000F, 0xFE000001, 0xFFFFE000, 
    0xFFFFFFFF, 0xFFFFFFFF, 0xFFFFFFFF, 0xFFFFFC00, 0xFF000007, 0xFE000003, 0xFFFFE000, 
    0xFFFFFFFF, 0xFFFFFFFF, 0xFFFFFFFF, 0xFFFFF801, 0xFE000007, 0xFF000007, 0xFFFFE000, 
    0xFFFFFFFF, 0xFFFFFFFF, 0xFFFFFFFF, 0xFFFFF801, 0xFE000003, 0xFF80000F, 0xFFFFE000, 
    0xFFFFFFFF, 0xFFFFFFFF, 0xFFFFFFFF, 0xFFFFF001, 0xFC000001, 0xFFC0001F, 0xFFFFE000, 
    0xFFFFFFFF, 0xFFFFFFFF, 0xFFFFFFFF, 0xFFFFF003, 0xFC000001, 0xFFC0000F, 0xFFFFE000, 
    0xFFFFFFFF, 0xFFFFFFFF, 0xFFFFFFFF, 0xFFFFE003, 0xFC000000, 0xFF000007, 0xFFFFE000, 
    0xFFFFFFFF, 0xFFFFFFFF, 0xFFFFFFFF, 0xFFFFE007, 0xFC00FC00, 0xFE000003, 0xFFFFE000, 
    0xFFFFFFFF, 0xFFFFFFFF, 0xFFFFFFFF, 0xFFFFC007, 0xF801FE00, 0xFE000001, 0xFFFFE000, 
    0xFFFFFFFF, 0xFFFFFFFF, 0xFFFFFFFF, 0xFFFFC00F, 0xF801FE00, 0x7C000001, 0xFFFFE000, 
    0xFFFFFFFF, 0xFFFFFFFF, 0xFFFFFFFF, 0xFFFF800F, 0xF803FF00, 0x78007800, 0xFFFFE000, 
    0xFFFFF9FF, 0xFCFCFFF3, 0xFFFF9FDF, 0xFFFF801F, 0xF003FF00, 0x7801FC00, 0xFFFFE000, 
    0xFFFFF9FF, 0xFDFCFFF7, 0xFFFF9F9F, 0xFFFF001F, 0xF003FF00, 0x7801FE00, 0xFFFFE000, 
    0xFFFFF9FF, 0xF9FCFFE4, 0x000F9F80, 0xFFFF003F, 0xF007FF00, 0x7003FE00, 0x7FFFE000, 
    0xFFFFF9FF, 0xFBFCFFEC, 0x000F9F00, 0xFFFE003F, 0xF007FF80, 0x7003FF00, 0x7FFFE000, 
    0xFFF80001, 0xF30003CF, 0xCCFC067D, 0xFFFC007F, 0xF807FF80, 0x7007FF00, 0x7FFFE000, 
    0xFFF80001, 0xF30003CF, 0xCCFC0439, 0xFFFC00FF, 0xF007FF00, 0x7007FF00, 0x7FFFE000, 
    0xFFFFE07F, 0xE3F87F8F, 0xCCFF9DDB, 0xFFF800FF, 0xF007FF00, 0x7007FF00, 0x7FFFE000, 
    0xFFFFE07F, 0xC3F07F0E, 0x001F9FC3, 0xFFF801FF, 0xF007FF00, 0x7007FF00, 0x60006000, 
    0xFFFFE07F, 0xC3F4BF4E, 0x001F8FE7, 0xFFF001FF, 0xF003FF00, 0x7007FF00, 0x60006000, 
    0xFFFFC93F, 0xFBE4BFCE, 0xCDDF07C3, 0xFFF003FF, 0xF003FF00, 0x7003FF00, 0x6F9F6000, 
    0xFFFF999F, 0xFBEC9FCE, 0xCDDF1738, 0xFFE003FF, 0xF803FE00, 0x7003FE00, 0x6F9F6000, 
    0xFFFFB9CF, 0xFBCCDFCE, 0xCDDF9C7E, 0x7FC007FF, 0xF801FC00, 0xF001FE00, 0x6F9F6000, 
    0xFFFF39C7, 0xFBDCCFCE, 0xCDDE9C00, 0x7FC007FF, 0xF800F800, 0xF001FC00, 0x6F9F6000, 
    0xFFFE79E3, 0xFB9CEFCE, 0xCDDE9F00, 0xFF800000, 0xF8000000, 0xF8002000, 0x6F9F6000, 
    0xFFF88011, 0xFB3CE7CE, 0xCDDD9F7E, 0xFF800000, 0xFC000001, 0xF8000000, 0xE0006000, 
    0xFFF98019, 0xFB6033CE, 0xCDDF9F7E, 0xFF000000, 0xFC000001, 0xF8000000, 0xEFFF6000, 
    0xFFFFF9FF, 0xFBE03FCE, 0xCDDF9F7E, 0xFF000000, 0xFE000003, 0xFC000001, 0xEFFF6000, 
    0xFFFFF9FF, 0xFBFCFFCE, 0x001F9F7E, 0xFE000000, 0xFF000003, 0xFE000003, 0xEFFF6000, 
    0xFFFFF9FF, 0xFBFCFFCE, 0x001F9F00, 0xFC000000, 0xFF800007, 0xFE000003, 0xEFFF6000, 
    0xFFFFF9FF, 0xFBFCFFCE, 0xFFDF9F00, 0xFC000000, 0xFFC0000F, 0xFF00000F, 0xEFFF6000, 
    0xFFFFFFFF, 0xFFFFFFFF, 0xFFFFFFFF, 0xF8000000, 0xFFE0001F, 0xFFC0001F, 0xEFFF6000, 
    0xFFFFFFFF, 0xFFFFFFFF, 0xFFFFFFFF, 0xF8000000, 0xFFF8007F, 0xFFF0007F, 0xEFFC6000, 
    0xFFFFFFFF, 0xFFFFFFFF, 0xFFFFFFFF, 0xFFFFFFFF, 0xFFFE01FF, 0xFFFC01FF, 0xFFFFE000, 
    0xFFFFFFFF, 0xFFFFFFFF, 0xFFFFFFFF, 0xFFFFFFFF, 0xFFFFFFFF, 0xFFFFFFFF, 0xFFFFE000, 
    0xFFFFFFFF, 0xFFFFFFFF, 0xFFFFFFFF, 0xFFFFFFFF, 0xFFFFFFFF, 0xFFFFFFFF, 0xFFFFE000, 
    0xFFFFFFFF, 0xFFFFFFFF, 0xFFFFFFFF, 0xFFFFFFFF, 0xFFFFFFFF, 0xFFFFFFFF, 0xFFFFE000, 
    0xFFFFFFFF, 0xFFFFFFFF, 0xFFFFFFFF, 0xFFFFFFFF, 0xFFFFFFFF, 0xFFFFFFFF, 0xFFFFE000, 
    0xFFFFFFFF, 0xFFFFFFFF, 0xFFFFFFFF, 0xFFFFFFFF, 0xFFFFFFFF, 0xFFFFFFFF, 0xFFFFE000, 
    0xFFFFFFFF, 0xFFFFFFFF, 0xFFFFFFFF, 0xFFFFFFFF, 0xFFFFFFFF, 0xFFFFFFFF, 0xFFFFE000, 
    0xFFFFFFFF, 0xFFFFFFFF, 0xFFFFFFFF, 0xFFFFFFFF, 0xFFFFFFFF, 0xFFFFFFFF, 0xFFFFE000, 
    0xFFFFFFFF, 0xFFFFFFFF, 0xFFFFFFFF, 0xFFFFFFFF, 0xFFFFFFFF, 0xFFFFFFFF, 0xFFFFE000, 
    0xFFFFFFFF, 0xFFFFFFFF, 0xFFFFFFFF, 0xFFFFFFFF, 0xFFFFFFFF, 0xFFFFFFFF, 0xFFFFE000, 
};

#endif // PNG_HEX_H
```
