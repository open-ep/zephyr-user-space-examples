## boards/kakip/samples/pixpaper_213m/apps/image/sample.yaml
```yaml
sample:
  name: pixpaper-213m e-paper - image (raw SPI) on Kakip CM33
  description: >
    Show a bundled image on the Open-EP pixpaper-213m 2.13" monochrome e-paper
    panel, driven over RSPI0 by the Cortex-M33 of the Kakip (RZ/V2H) board.
tests:
  sample.boards.kakip.pixpaper_213m.image:
    platform_allow:
      - rzv2h_evk/r9a09g057h44gbg/cm33
    tags:
      - spi
      - gpio
      - displays
    depends_on:
      - spi
      - gpio
    build_only: true
```

## boards/kakip/samples/pixpaper_426m/dts/bindings/display/open-ep,pixpaper-426m.yaml
```yaml
# SPDX-License-Identifier: Apache-2.0

description: |
  Open-EP pixpaper-426m 4.26" 800x480 monochrome e-paper panel, driven over raw SPI.
  DC/RST are plain GPIOs and BUSY is read back.

compatible: "open-ep,pixpaper-426m"

include: [spi-device.yaml, display-controller.yaml]

properties:
  dc-gpios:
    type: phandle-array
    required: true
    description: Data/command select. Low = command, high = data.

  reset-gpios:
    type: phandle-array
    required: true
    description: Hardware reset. Driven low to reset.

  busy-gpios:
    type: phandle-array
    required: true
    description: BUSY status, active high (panel busy while high).
```
