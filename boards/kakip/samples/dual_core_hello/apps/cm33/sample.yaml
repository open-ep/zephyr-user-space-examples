## boards/kakip/samples/dual_core_hello/apps/cm33/sample.yaml
```yaml
sample:
  name: Kakip dual-core hello - CM33 (console + CR8 log relay)
  description: >
    Zephyr on the RZ/V2H Cortex-M33 of the Kakip board: prints its own heartbeat
    on SCI5 and relays the Cortex-R8 log from a ring buffer in shared SRAM.
tests:
  sample.boards.kakip.dual_core_hello.cm33:
    platform_allow:
      - rzv2h_evk/r9a09g057h44gbg/cm33
    tags:
      - uart
    build_only: true
```

## boards/w6300_evb_pico2/samples/pixpaper_213m/apps/boot-image/sample.yaml
```yaml
sample:
  name: pixpaper-213m e-paper - boot image
  description: >
    Draw a bundled image on the Open-EP pixpaper-213m 2.13" mono e-paper panel at boot, then put the panel into deep sleep.
tests:
  sample.boards.openep.w6300_evb_pico2.boot_image:
    platform_allow:
      - w6300_evb_pico2/rp2350a/m33
      - rpi_pico2/rp2350a/m33
    tags:
      - gpio
      - displays
    depends_on:
      - gpio
    build_only: true
```

## boards/w6300_evb_pico2/samples/pixpaper_213m/apps/showcase/sample.yaml
```yaml
sample:
  name: pixpaper-213m e-paper - showcase loop
  description: >
    Infinite scene loop on the pixpaper-213m: self-playing Tetris, Snake and Pong via partial updates, a static image, and two 4-level grayscale images.
tests:
  sample.boards.openep.w6300_evb_pico2.showcase:
    platform_allow:
      - w6300_evb_pico2/rp2350a/m33
      - rpi_pico2/rp2350a/m33
    tags:
      - gpio
      - displays
    depends_on:
      - gpio
    build_only: true
```

## boards/w6300_evb_pico2/samples/pixpaper_213m/apps/video/sample.yaml
```yaml
sample:
  name: pixpaper-213m e-paper - video player
  description: >
    Play a pre-packed .epdv clip embedded in flash on the pixpaper-213m, looping forever with full-frame partial refreshes.
tests:
  sample.boards.openep.w6300_evb_pico2.video:
    platform_allow:
      - w6300_evb_pico2/rp2350a/m33
      - rpi_pico2/rp2350a/m33
    tags:
      - gpio
      - displays
    depends_on:
      - gpio
    build_only: true
```
