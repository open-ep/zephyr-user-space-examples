## CMakeLists.txt
```
# SPDX-License-Identifier: Apache-2.0

cmake_minimum_required(VERSION 3.20.0)

# Keeps the last 4 KB of R8SRAM free for the shared log ring, drops the EVK console.
set(EXTRA_DTC_OVERLAY_FILE ${CMAKE_CURRENT_SOURCE_DIR}/../../common/kakip_cr8.overlay)

# The CR8 image has two load regions: the vector table at CR8 address 0 (ITCM) and
# everything else in R8SRAM. Write them as two files for U-Boot to copy separately.
# Must be set before find_package(Zephyr): that is where the post-build list is read.
set(elf ${CMAKE_BINARY_DIR}/zephyr/zephyr.elf)
set_property(GLOBAL APPEND PROPERTY extra_post_build_commands
  COMMAND $<TARGET_PROPERTY:bintools,elfconvert_command> -O binary -j rom_start
          ${elf} ${CMAKE_BINARY_DIR}/zephyr/cr8_itcm.bin
  COMMAND $<TARGET_PROPERTY:bintools,elfconvert_command> -O binary -R rom_start
          ${elf} ${CMAKE_BINARY_DIR}/zephyr/cr8_sram.bin
)

find_package(Zephyr REQUIRED HINTS $ENV{ZEPHYR_BASE})
project(kakip_dual_core_hello_cr8)

target_sources(app PRIVATE src/main.c)
target_include_directories(app PRIVATE ../../common)
```

## sample.yaml
```
sample:
  name: Kakip dual-core hello - CR8 (printk into shared SRAM)
  description: >
    Zephyr on the RZ/V2H Cortex-R8 core 0 of the Kakip board: no UART of its own,
    its printk output goes into a ring buffer in R8SRAM that the Cortex-M33 relays.
tests:
  sample.boards.kakip.dual_core_hello.cr8:
    platform_allow:
      - rzv2h_evk/r9a09g057h44gbg/cr8_0
    build_only: true
```

## prj.conf
```kconfig
CONFIG_PRINTK=y
# no UART on this core: printk goes to the shared ring (src/main.c)
CONFIG_SERIAL=n
CONFIG_CONSOLE=n
CONFIG_UART_CONSOLE=n
# zephyr.bin would span 0x0 (ITCM vectors) .. 0x0818xxxx (SRAM) = ~135 MB of padding;
# CMakeLists.txt writes the two loadable pieces instead (cr8_itcm.bin, cr8_sram.bin)
CONFIG_BUILD_OUTPUT_BIN=n
```

## src/main.c
```c
/* SPDX-License-Identifier: Apache-2.0 */

/* Kakip CR8_0 hello: printk -> shared ring in R8SRAM, forwarded to a UART by the CM33. */
#include <zephyr/kernel.h>
#include <zephyr/init.h>
#include <zephyr/cache.h>
#include <zephyr/sys/barrier.h>
#include <zephyr/sys/printk.h>
#include <zephyr/sys/printk-hooks.h>
#include "shlog.h"

static struct shlog *const L = (struct shlog *)SHLOG_PHYS;

static void flush(volatile void *p, size_t n)
{
	/* CR8 has a data cache; the CM33 reads SRAM directly */
	sys_cache_data_flush_range((void *)p, n);
}

static int shlog_out(int c)
{
	uint32_t h = L->head;

	L->buf[h % SHLOG_SIZE] = (char)c;
	flush(&L->buf[h % SHLOG_SIZE], 1);
	barrier_dmem_fence_full();     /* byte lands before the reader sees the new head */
	L->head = h + 1;
	flush(&L->head, sizeof(L->head));
	return c;
}

static int shlog_init(void)
{
	L->magic = 0;
	flush(&L->magic, sizeof(L->magic));
	L->head = 0;
	L->boots = L->boots + 1;
	flush(L, 16);
	barrier_dmem_fence_full();
	L->magic = SHLOG_MAGIC;
	flush(&L->magic, sizeof(L->magic));
	__printk_hook_install(shlog_out);
	return 0;
}
SYS_INIT(shlog_init, PRE_KERNEL_1, 0);   /* before the boot banner */

int main(void)
{
	printk("Hello World from Zephyr on Kakip CR8_0 (%s)\n", CONFIG_BOARD_TARGET);
	for (unsigned int n = 0;; n++) {
		printk("tick %u\n", n);
		k_sleep(K_SECONDS(1));
	}
	return 0;
}
```
